## doorbell-chime/src/doorbell_chime/sdkconfig.defaults.esp32
```kconfig
CONFIG_BT_NIMBLE_MSYS_1_BLOCK_COUNT=30
CONFIG_BT_NIMBLE_ATT_PREFERRED_MTU=247
CONFIG_BT_NIMBLE_HS_FLOW_CTRL=n
CONFIG_MBEDTLS_HARDWARE_ECDSA=y
CONFIG_MBEDTLS_HARDWARE_SHA=y

CONFIG_COMPILER_OPTIMIZATION_SIZE=y
```
